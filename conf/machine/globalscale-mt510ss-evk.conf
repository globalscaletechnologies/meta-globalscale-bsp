## conf/machine/globalscale-mt510ss-evk.conf
```bitbake
require conf/machine/include/mt8370.inc
require conf/machine/include/mt7921.inc

# Kernel
KERNEL_DEVICETREE = "mediatek/mt8370-gti-cortadobin.dtb"

# U-Boot
UBOOT_MACHINE = "globalscale_mt510ss_evk_defconfig"

# libdram
LIBDRAM_BOARD_NAME = "genio-700-evk"

# OP-TEE
OPTEE_DRAM_SIZE = "0x200000000"

# LK
LK_BOARD_NAME = "${LIBDRAM_BOARD_NAME}"

DISTRO_FEATURES:append = " dtbo "
MACHINE_FEATURES:append = " alsa bluetooth pci usbgadget usbhost wifi tsn uc-fde"

MACHINEOVERRIDES =. "mt8370-evk:globalscale-mt510ss-evk:"
```
