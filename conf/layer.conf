## conf/layer.conf
```bitbake
# We have a conf and classes directory, add to BBPATH
BBPATH .= ":${LAYERDIR}"

# We have recipes-* directories, add to BBFILES
BBFILES += "${LAYERDIR}/recipes-*/*/*.bb \
            ${LAYERDIR}/recipes-*/*/*.bbappend"

BBFILE_COLLECTIONS += "globalscale-bsp"
BBFILE_PATTERN_globalscale-bsp = "^${LAYERDIR}/"
BBFILE_PRIORITY_globalscale-bsp = "6"

LAYERDEPENDS_globalscale-bsp = "rity core mediatek-bsp multimedia-layer"
LAYERSERIES_COMPAT_globalscale-bsp = "kirkstone"
```
